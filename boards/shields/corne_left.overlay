/ {
    backlight: backlight {
        compatible = "zmk,backlight";
        label = "Backlight";
        chain-length = <27>;              // Number of SK6812 LEDs
        color-order = <0>;                // 0 = RGB, 1 = GRB (adjust if needed)
        data-gpios = <&gpio0 4 GPIO_ACTIVE_HIGH>; // Update with your actual data pin
    };

    chosen {
        zmk,backlight = &backlight;
    };
};
